#include "robot.h"

#if PWM_CONTROLLER_TYPE == ESP32PWM
#include <esp32-hal-periman.h>
#if CONFIG_IDF_TARGET_ESP32
	#include <soc/ledc_struct.h>
#endif
/**
 * Servo PWM generated by the ESP32 LEDC hardware peripheral.
 *
 * This replaces ESP32_ISR_Servo, which bit-banged every servo pin from a
 * hardware timer interrupt firing every few microseconds. That approach
 * fights the WiFi stack for CPU time and interrupt latency (and stalls
 * whenever the flash cache is disabled, e.g. during WiFi/NVS/EEPROM writes),
 * which is what caused servo jitter and instability together with WiFi and
 * websockets on newer cores. LEDC produces the pulses fully in hardware, so
 * WiFi load has no effect on servo timing and no CPU time is spent on PWM.
 *
 * The ESP32 has 16 LEDC channels, so up to 16 servos can be driven directly
 * (the quadruped uses 12). Use a PCA9685 for more.
 *
 * A new duty only takes effect at the start of the next PWM period (20 ms at
 * 50 Hz). On the original ESP32, ESP-IDF 5.5 (Arduino core 3.3) ledcWrite()
 * busy-waits, with interrupts off, until the previous update of that channel
 * has taken effect. Written every motion tick, each write waited for the next
 * period: ~20 ms per LEDC group, ~40 ms per tick for 12 servos (the robot ran
 * at a ninth of its loop rate). So write() never waits: an unchanged pulse is
 * not written again, and while a channel's previous update is still pending
 * the new pulse is left for the next tick. The servo reads the pulse once per
 * period anyway, so it still gets the newest value.
 */

#ifndef ESP32PWM_SERVO_FREQ
	#define ESP32PWM_SERVO_FREQ 50   // Hz, standard analog servo frame (20ms)
#endif
#ifndef ESP32PWM_SERVO_RESOLUTION
	#define ESP32PWM_SERVO_RESOLUTION 16   // bits, ~0.3us per step at 50Hz
#endif

#define ESP32PWM_SERVO_PERIOD_US (1000000UL / ESP32PWM_SERVO_FREQ)
#define ESP32PWM_SERVO_COUNT     (LEG_NUM * LEG_DOF)

#ifdef SOC_LEDC_SUPPORT_HS_MODE
	#define ESP32PWM_LEDC_CHANNELS (SOC_LEDC_CHANNEL_NUM * 2)   // high + low speed groups
#else
	#define ESP32PWM_LEDC_CHANNELS SOC_LEDC_CHANNEL_NUM
#endif

#if ESP32PWM_SERVO_COUNT > ESP32PWM_LEDC_CHANNELS
	#error "Not enough LEDC channels for all servos, use PCA9685 instead"
#endif

class LedcServoBus : public ServoBus {
	public:
		const char *name() const override { return "ESP32 LEDC " ; }

		bool begin(const uint8_t *channels, uint8_t count) override
		{
			Serial.printf("%uHz/%ubit ", ESP32PWM_SERVO_FREQ, ESP32PWM_SERVO_RESOLUTION);
			bool ok = true;
			_count = count;
			for (uint8_t i = 0; i < count; i++) {
				_pins[i]    = channels[i];
				_channel[i] = NO_CHANNEL;
				_duty[i]    = 0;
				if (!ledcAttach(_pins[i], ESP32PWM_SERVO_FREQ, ESP32PWM_SERVO_RESOLUTION)) {
					Serial.printf("LEDC attach failed for pin %u\n", _pins[i]);
					ok = false;
					continue;
				}
				ledcWrite(_pins[i], 0);   // no pulses until the first position is known
				_duty[i] = 0;
				ledc_channel_handle_t *h = (ledc_channel_handle_t *)perimanGetPinBus(_pins[i], ESP32_BUS_TYPE_LEDC);
				_channel[i] = h ? h->channel : NO_CHANNEL;
			}
			return ok;
		}

		void write(uint8_t index, uint16_t us) override
		{
			if (index >= _count) {
				return;
			}
			uint32_t duty = 0;
			if (_enabled && us != 0) {
				if (us < SERVO_MIN) us = SERVO_MIN;
				if (us > SERVO_MAX) us = SERVO_MAX;
				duty = ((uint32_t)us << ESP32PWM_SERVO_RESOLUTION) / ESP32PWM_SERVO_PERIOD_US;
			}
			if (duty == _duty[index] || updatePending(index)) {
				return;   // nothing new, or retried next tick (see above)
			}
			ledcWrite(_pins[index], duty);
			_duty[index] = duty;
		}

		// Disabled: stop sending pulses, servos go limp. Pulses come back on the next write.
		void setEnabled(bool enabled) override
		{
			_enabled = enabled;
			if (!enabled) {
				// rare (CLI, battery critical): fine to wait for each channel here
				for (uint8_t i = 0; i < _count; i++) {
					ledcWrite(_pins[i], 0);
					_duty[i] = 0;
				}
			}
		}

		uint8_t channelLimit() const override { return 40; }   // GPIO numbers

		const char *checkChannel(uint8_t pin) const override
		{
			switch (pin) {
				case 0: case 2: case 5: case 12: case 15:
					return "strapping pin, the board may fail to boot";
				case 34: case 35: case 36: case 37: case 38: case 39:
					return "input only pin";
			}
			return nullptr;
		}

	private:
		static const uint8_t NO_CHANNEL = 0xFF;

		// true while the channel's last duty update hasn't reached the output
		// yet, so ledcWrite() would block until the next PWM period
		bool updatePending(uint8_t index) const
		{
		#if CONFIG_IDF_TARGET_ESP32
			uint8_t ch = _channel[index];
			if (ch == NO_CHANNEL) {
				return false;
			}
			return LEDC.channel_group[ch / 8].channel[ch % 8].conf1.duty_start;
		#else
			(void)index;
			return false;   // later chips don't wait in ledcWrite()
		#endif
		}

		uint8_t  _pins[ESP32PWM_SERVO_COUNT]    = {};
		uint8_t  _channel[ESP32PWM_SERVO_COUNT] = {};
		uint32_t _duty[ESP32PWM_SERVO_COUNT]    = {};   // last duty written
		uint8_t _count   = 0;
		bool    _enabled = true;
};

ServoBus &servoBus()
{
	static LedcServoBus bus;
	return bus;
}
#endif
